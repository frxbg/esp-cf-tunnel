## components/esp_cf_tunnel/Kconfig
```kconfig
menu "Cloudflare Tunnel experimental profiles"
    config CF_TUNNEL_HTTP2
        bool "Build the bounded upstream HTTP/2 server engine"
        default n
        help
            Portable HTTP/2 engine. Does not start network or TLS connections.
    config CF_TUNNEL_ESP_TRANSPORT
        bool "Build the experimental ESP-TLS named tunnel connector"
        select CF_TUNNEL_HTTP2
        select MBEDTLS_SSL_PROTO_TLS1_3 if ESP_TLS_USING_MBEDTLS
        default n
        help
            IPv4 DNS discovery, TLS client, HTTP/2 server, registration and
            configuration. Application owns network/time and native backend.
            TLS 1.3 is required by current edge endpoints. TLS certificate and
            hostname verification remain enabled.
    config CF_TUNNEL_APPLICATION_STREAMS
        int "Example application stream slots (2 or 4)"
        range 2 4
        default 4
        help
            Example input to esp_cf_tunnel_init. Select 2 or 4; the API rejects
            3. Does not include the separate control/config stream slots.
    config CF_TUNNEL_BODY_CHUNK
        int "Application chunk bytes (current transport bound)"
        range 2048 2048
        default 2048
        help
            Fixed at CF_H2_CHUNK for this port. This is not a TLS record or
            HTTP/2 frame limit; legal 16 KiB frames are consumed in chunks.
endmenu
```

## examples/protocol_smoke/sdkconfig.defaults
```kconfig
CONFIG_COMPILER_OPTIMIZATION_SIZE=y
CONFIG_CF_TUNNEL_ESP_TRANSPORT=y
CONFIG_CF_TUNNEL_APPLICATION_STREAMS=4
CONFIG_CF_TUNNEL_BODY_CHUNK=2048
```

## examples/system_monitor/sdkconfig.defaults
```kconfig
CONFIG_COMPILER_OPTIMIZATION_SIZE=y
CONFIG_ESPTOOLPY_FLASHSIZE_16MB=y
CONFIG_PARTITION_TABLE_CUSTOM=y
CONFIG_PARTITION_TABLE_CUSTOM_FILENAME="partitions.csv"
CONFIG_ESP_MAIN_TASK_STACK_SIZE=6144
CONFIG_HTTPD_MAX_REQ_HDR_LEN=1024
CONFIG_HTTPD_MAX_URI_LEN=128
CONFIG_ESP_WIFI_NVS_ENABLED=n
CONFIG_LWIP_MAX_SOCKETS=10
CONFIG_ESP_DEFAULT_CPU_FREQ_MHZ_240=y
CONFIG_MBEDTLS_SSL_IN_CONTENT_LEN=16384
CONFIG_CF_TUNNEL_ESP_TRANSPORT=y
CONFIG_BOOTLOADER_APP_ROLLBACK_ENABLE=y
```
